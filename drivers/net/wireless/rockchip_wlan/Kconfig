## drivers/net/wireless/rockchip_wlan/Kconfig
```kconfig
# SPDX-License-Identifier: GPL-2.0
source "drivers/net/wireless/rockchip_wlan/rk915/Kconfig"
```

## drivers/soc/rockchip/Kconfig
```kconfig
# SPDX-License-Identifier: GPL-2.0-only
if ARCH_ROCKCHIP || COMPILE_TEST

#
# Rockchip Soc drivers
#

config ROCKCHIP_GRF
	bool "Rockchip General Register Files support" if COMPILE_TEST
	default y if ARCH_ROCKCHIP
	help
	  The General Register Files are a central component providing
	  special additional settings registers for a lot of soc-components.
	  In a lot of cases there also need to be default settings initialized
	  to make some of them conform to expectations of the kernel.

config ROCKCHIP_CPUINFO
	tristate "Rockchip cpuinfo support"
	depends on OF
	default y if ARCH_ROCKCHIP
	help
	  Say y here to enable support for reading Rockchip cpu info, such as
	  distinguishing SoC variants (e.g. PX30 vs PX30S) that share the same
	  base compatible string but differ in silicon revision, detected via
	  either an OTP-provisioned ID or a direct hardware register read.

config ROCKCHIP_PM_CONFIG
	bool "Rockchip PX30S suspend wakeup configuration support"
	depends on OF && HAVE_ARM_SMCCC
	default y if ARCH_ROCKCHIP
	help
	  Say y here to forward this board's sleep-mode/wakeup-source
	  configuration to BL31 firmware via SIP calls on every suspend
	  attempt, required for PX30S's firmware-controlled deep suspend
	  states to correctly arm wake sources. Built-in only (not a
	  module) since it reads the kernel's own mem_sleep_current state.

config ROCKCHIP_RK3326_PVTM
	bool "RK3326 CPU quality grade report"
	depends on CPUFREQ_DT && REGULATOR && MFD_SYSCON && THERMAL
	help
	  Measure the CPU's ring oscillator once at boot, as the Rockchip BSP
	  does to pick voltages, and print the grade for EmulationStation.

config ROCKCHIP_IODOMAIN
	tristate "Rockchip IO domain support"
	depends on OF
	help
	  Say y here to enable support io domains on Rockchip SoCs. It is
	  necessary for the io domain setting of the SoC to match the
	  voltage supplied by the regulators.

config ROCKCHIP_DTPM
	tristate "Rockchip DTPM hierarchy"
	depends on DTPM && m
	help
	  Describe the hierarchy for the Dynamic Thermal Power Management tree
	  on this platform. That will create all the power capping capable
	  devices.

endif
```
